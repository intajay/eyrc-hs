/*
 * Team Id : eYRC-HS#1529
 
 * Author List : Ajay Meena
 
 * Filename: Arena_traverse.c
 
 * Theme: Hotel Guest Service
 
 * Functions: 
 * void port_init();
 * void timer5_init();
 * void adc_init();
 * unsigned char ADC_Conversion(unsigned char);
 * void search_blk(unsigned int);
 * void follow_blk(unsigned char);
 * void follow_wall_l(unsigned int,unsigned char);
 * void follow_wall_r(unsigned int,unsigned char);
 * void angle_rotate(unsigned int);
 * void linear_distance_mm(unsigned int,unsigned char);
 * void velocity(unsigned char, unsigned char);
 * unsigned int Sharp_GP2D12_estimation(unsigned char);
 
 * Global Variables: 
 * volatile unsigned long int pulse = 0;
 * volatile unsigned long int red;
 * volatile unsigned long int blue;
 * volatile unsigned long int green;
 * volatile unsigned long int no_ff;
 * volatile unsigned long int highest;
 * volatile unsigned long int ShaftCountLeft = 0;
 * volatile unsigned long int ShaftCountRight = 0;
 * volatile unsigned char Left_white_line = 0;
 * volatile unsigned char Center_white_line = 0;
 * volatile unsigned char Right_white_line = 0;
 * volatile unsigned char distance, adc_reading;
 * volatile unsigned int sharp_l = 0,sharp_r = 0;
 * volatile unsigned int Degrees = 0;
 * volatile unsigned char speed = 0;
 * volatile unsigned int l_arr_thres[4] = {197,218,238,247};
 * volatile unsigned int r_arr_thres[4] = {289,278,327,308};
 * volatile unsigned int l_thres,r_thres;
 */


#define __OPTIMIZE__ -O0
#define F_CPU 14745600
#include <avr/io.h>
#include <avr/interrupt.h>
#include <util/delay.h>
#include <math.h>
#include "lcd.h"
#define thres_red 35  //threshold values
#define thres_blue 36
#define thres_green 28

void port_init();
void timer5_init();
void adc_init();
unsigned char ADC_Conversion(unsigned char);
void search_blk(unsigned int);
void follow_blk(unsigned char);
void follow_wall_l(unsigned int,unsigned char);
void follow_wall_r(unsigned int,unsigned char);
void angle_rotate(unsigned int);
void linear_distance_mm(unsigned int,unsigned char);
void velocity(unsigned char, unsigned char);
unsigned int Sharp_GP2D12_estimation(unsigned char);

volatile unsigned long int pulse = 0; //Pulse count
volatile unsigned long int red;  //red count
volatile unsigned long int blue; //blue count
volatile unsigned long int green; //green count
volatile unsigned long int no_ff; //no filter count
volatile unsigned long int highest; //highest value in all count
volatile unsigned long int ShaftCountLeft = 0;
volatile unsigned long int ShaftCountRight = 0;
volatile unsigned char Left_white_line = 0; 
volatile unsigned char Center_white_line = 0;
volatile unsigned char Right_white_line = 0;
volatile unsigned char distance, adc_reading;
volatile unsigned int sharp_l = 0,sharp_r = 0;  //distance from the left and right walls 
volatile unsigned int Degrees = 0;  //angle
volatile unsigned char speed = 0;  //velocity
volatile unsigned int l_arr_thres[4] = {197,218,238,247}; //threshold values to move in the middle of wall for specified room
volatile unsigned int r_arr_thres[4] = {289,278,327,308}; //threshold values to move in the middle of wall for specified room
volatile unsigned int l_thres,r_thres;  //threshold values to move in the middle of wall
/*
 * Function Name: void rgb_port_config(void)
 * Input : void
 * Output : void
 * Logic: Function to configure ports for RGB LED
 * Green of the sensor is connected to PL0 of Atmega 2560 i.e Pin 28 on expansion slot
 * Blue of the sensor is connected to PL1 of Atmega 2560 i.e Pin 27 on expansion slot
 * Red of the sensor is connected to PL2 of Atmega 2560 i.e Pin 30 on expansion slot
 * Anode of the sensor is connected to 5V of Atmega 2560 i.e Pin 21 on expansion slot
 * Example Call: rgb_port_config();
 */
void rgb_port_config(void)
{
	DDRL = DDRL | 0x07;   //set direction of the PORTL 2 to PORTL 0 pins as output
	PORTL = PORTL | 0x07;   // set initial value of the PORTL 2 to PORTA 0 pins to logic 1
}

/*
 * Function Name: void lcd_port_config (void)
 * Input : void
 * Output : void
 * Logic: Function to configure ports for LCD display
 * Example Call: lcd_port_config();
 */
void lcd_port_config (void)
{
	DDRC = DDRC | 0xF7; //setting all the LCD pin's direction set as output
	PORTC = PORTC & 0x80; //setting all the LCD pins are set to logic 0 except PORTC 7
}

/*
 * Function Name: void color_sensor_pin_config(void)
 * Input : void
 * Output : void
 * Logic: Function to configure output ports and input pins for color sensor
 
 * Micro-controller pins used:
 * PORTD0 (INT0): External Interrupt used to count the number of pulses generated by the color sensor
 * PORTD4 & PORTD5: Control the S0 and S1 pins of the color sensor to choose a scaling factor
 * PORTD6 & PORTD7: Control S2 and S3 pins of the color sensor to choose the color filter.
 
 *Connections:
 *Vcc is connected on servo pod pin 7
 *Vdd is connected on servo pod pin 6
 *Output of the sensor is connected to PD0 (INT0) of Atmega 2560 i.e Pin 20 on expansion slot
 *S0 of the sensor is connected to PD4 of Atmega 2560 i.e Pin 25 on expansion slot
 *S1 of the sensor is connected to PD5 of Atmega 2560 i.e Pin 29 on expansion slot
 *S2 of the sensor is connected to PD6 of Atmega 2560 i.e Pin 33 on expansion slot
 *S3 of the sensor is connected to PD7 of Atmega 2560 i.e Pin 34 on expansion slot
 
 * Example Call: color_sensor_pin_config();
 */
void color_sensor_pin_config(void)
{
	DDRD  = DDRD | 0xFE; //set PD0 as input for color sensor output
	PORTD = PORTD | 0x01; //Enable internal pull-up for PORTD 0 pin
}

/*
 * Function Name: void motion_pin_config (void)
 * Input : void
 * Output : void
 * Logic: Function to configure output ports and input pins for color sensor
 
 * There are two components to the motion control:
 1. Direction control using pins PORTA0 to PORTA3
 2. Velocity control by PWM on pins PL3 and PL4 using OC5A and OC5B of timer 5.
 
 * Connection Details:  	
 L-1---->PA0;		L-2---->PA1;
 R-1---->PA2;		R-2---->PA3;
 PL3 (OC5A) ----> PWM left; 	PL4 (OC5B) ----> PWM right;
 
 * Example Call: motion_pin_config();
 */
void motion_pin_config (void)
{
	DDRA = DDRA | 0x0F;   //set direction of the PORTA 3 to PORTA 0 pins as output
	PORTA = PORTA & 0xF0;   // set initial value of the PORTA 3 to PORTA 0 pins to logic 0
	DDRL = DDRL | 0x18;   //Setting PL3 and PL4 pins as output for PWM generation
	PORTL = PORTL | 0x18; //PL3 and PL4 pins are for velocity control using PWM.
}

/*
 * Function Name: void left_encoder_pin_config (void)
 * Input : void
 * Output : void
 * Logic: Function to configure INT4 (PORTE 4) pin as input for the left position encoder
 * PE4 (INT4): External interrupt for left motor position encoder
 
 * Example Call: left_encoder_pin_config();
 */
void left_encoder_pin_config (void)
{
	DDRE  = DDRE & 0xEF;  //Set the direction of the PORTE 4 pin as input
	PORTE = PORTE | 0x10; //Enable internal pull-up for PORTE 4 pin
}

/*
 * Function Name: void right_encoder_pin_config (void)
 * Input : void
 * Output : void
 * Logic: Function to configure INT5 (PORTE 5) pin as input for the right position encoder
 * PE5 (INT5): External interrupt for the right position encoder
 
 * Example Call: right_encoder_pin_config();
 */
void right_encoder_pin_config (void)
{
	DDRE  = DDRE & 0xDF;  //Set the direction of the PORTE 5 pin as input
	PORTE = PORTE | 0x20; //Enable internal pull-up for PORTE 5 pin
}

/*
 * Function Name: void adc_pin_config (void)
 * Input : void
 * Output : void
 * Logic: Function to configure pins for ADC Conversion
 * Example Call: adc_pin_config();
 */
void adc_pin_config (void)
{
	DDRF = 0x00; //set PORTF direction as input
	PORTF = 0x00; //set PORTF pins floating
	DDRK = 0x00; //set PORTK direction as input
	PORTK = 0x00; //set PORTK pins floating
}

/*
 * Function Name: void port_init()
 * Input : void
 * Output : void
 * Logic: Function to initialize ports
 * Example Call: port_init();
 */
void port_init()
{	
	lcd_port_config(); //lcd pin configuration
	motion_pin_config(); //robot motion pins config
	left_encoder_pin_config(); //left encoder pin config
	right_encoder_pin_config(); //right encoder pin config
	adc_pin_config(); //adc pin configuration
	color_sensor_pin_config(); //color sensor pin configuration
	rgb_port_config(); //rgb led pin configuration
}

/*
 * Function Name: void color_sensor_pin_interrupt_init(void)
 * Input : void
 * Output : void
 * Logic: Function to enable Interrupt 0 (INT0)
 * Example Call: color_sensor_pin_interrupt_init();
 */
void color_sensor_pin_interrupt_init(void)
{
	cli(); //Clears the global interrupt
	EICRA = EICRA | 0x02; // INT0 is set to trigger with falling edge
	EIMSK = EIMSK | 0x01; // Enable Interrupt INT0 for color sensor
	sei(); // Enables the global interrupt
}

//ISR for color sensor
ISR(INT0_vect)
{
	pulse++; //increment on receiving pulse from the color sensor
}

/*
 * Function Name: void left_position_encoder_interrupt_init (void)
 * Input : void
 * Output : void
 * Logic: Function to enable Interrupt 4 (INT4)
 * Example Call: left_position_encoder__interrupt_init();
 */
void left_position_encoder_interrupt_init (void)
{
	cli(); //Clears the global interrupt
	EICRB = EICRB | 0x02; // INT4 is set to trigger with falling edge
	EIMSK = EIMSK | 0x10; // Enable Interrupt INT4 for left position encoder
	sei();   // Enables the global interrupt
}

/*
 * Function Name: void right_position_encoder_interrupt_init (void)
 * Input : void
 * Output : void
 * Logic: Function to enable Interrupt 5 (INT5)
 * Example Call: right_position_encoder__interrupt_init();
 */
void right_position_encoder_interrupt_init (void)
{
	cli(); //Clears the global interrupt
	EICRB = EICRB | 0x08; // INT5 is set to trigger with falling edge
	EIMSK = EIMSK | 0x20; // Enable Interrupt INT5 for right position encoder
	sei();   // Enables the global interrupt
}

//ISR for right position encoder
ISR(INT5_vect)
{
	ShaftCountRight++;  //increment right shaft position count
}

//ISR for left position encoder
ISR(INT4_vect)
{
	ShaftCountLeft++;  //increment left shaft position count
}

/*
 * Function Name: void adc_init()
 * Input : void
 * Output : void
 * Logic: Function to Initialize ADC
 * Example Call: adc_init();
 */
void adc_init()
{
	ADCSRA = 0x00;
	ADCSRB = 0x00;		//MUX5 = 0
	ADMUX = 0x20;		//Vref=5V external --- ADLAR=1 --- MUX4:0 = 0000
	ACSR = 0x80;
	ADCSRA = 0x86;		//ADEN=1 --- ADIE=1 --- ADPS2:0 = 1 1 0
}

/*
 * Function Name: unsigned char ADC_Conversion(unsigned char Ch)
 * Input : Ch (Input pins for sensors)
 * Output : a (Analog Value corresponding to the channel)
 * Logic: Function for 8 bit ADC_Conversion
 * Example Call: ADC_Conversion(4);
 */
unsigned char ADC_Conversion(unsigned char Ch)
{
	unsigned char a;   //Analog value
	if(Ch>7)
	{
		ADCSRB = 0x08;
	}
	Ch = Ch & 0x07;
	ADMUX= 0x20| Ch;
	ADCSRA = ADCSRA | 0x40;		//Set start conversion bit
	while((ADCSRA&0x10)==0);	//Wait for ADC conversion to complete
	a=ADCH;
	ADCSRA = ADCSRA|0x10; //clear ADIF (ADC Interrupt Flag) by writing 1 to it
	ADCSRB = 0x00;
	return a;
}

/*
 * Function Name: unsigned int Sharp_GP2D12_estimation(unsigned char adc_reading)
 * Input : adc_reading (Analog value from function ADC_Conversion)
 * Output : distanceInt (Distance in mm)
 * Logic: This Function calculates the actual distance in millimeters(mm) from the input
   analog value of Sharp Sensor.
 * Formula: distance = (int)(10.00*(2799.6*(1.00/(pow(adc_reading,1.1546)))));
 * Example Call: Sharp_GP2D12_estimation(ADC_Conversion(9));
 */
unsigned int Sharp_GP2D12_estimation(unsigned char adc_reading)
{
	float distance; //Floating distance
	unsigned int distanceInt;  //Integer distance
	distance = (int)(10.00*(2799.6*(1.00/(pow(adc_reading,1.1546))))); //Formula to calculate distance
	distanceInt = (int)distance;
	if(distanceInt>800)  //Range of sharp sensor is 10-80 CM
	{
		distanceInt=800;
	}
	return distanceInt;
}

/*
 * Function Name: void motion_set (unsigned char Direction)
 * Input : Direction (logic 1 and/or 0 on lower nibbel of PORTA)
 * Output : void
 * Logic: Function used for setting motor's direction
 * Example Call: motion_set(0x06);
 */
void motion_set (unsigned char Direction)
{
	unsigned char PortARestore = 0;

	Direction &= 0x0F; 		// removing upper nibbel for the protection
	PortARestore = PORTA; 		// reading the PORTA original status
	PortARestore &= 0xF0; 		// making lower direction nibbel to 0
	PortARestore |= Direction; // adding lower nibbel for forward command and restoring the PORTA status
	PORTA = PortARestore; 		// executing the command
}

void forward (void) //both wheels forward
{
	motion_set(0x06);
}

void back (void) //both wheels backward
{
	motion_set(0x09);
}

void left (void) //Left wheel backward, Right wheel forward
{
	motion_set(0x05);
}

void right (void) //Left wheel forward, Right wheel backward
{
	motion_set(0x0A);
}

void soft_left (void) //Left wheel stationary, Right wheel forward
{
	motion_set(0x04);
}

void soft_right (void) //Left wheel forward, Right wheel is stationary
{
	motion_set(0x02);
}

void soft_left_2 (void) //Left wheel backward, right wheel stationary
{
	motion_set(0x01);
}

void soft_right_2 (void) //Left wheel stationary, Right wheel backward
{
	motion_set(0x08);
}

void stop (void)  ////both wheels stationary
{
	motion_set(0x00);
}

/*
 * Function Name: timer5_init
 * Input : None
 * Output : None
 * Logic: 
    Timer 5 initialized in PWM mode for velocity control
    Prescale:256
    PWM 8bit fast, TOP=0x00FF
    Timer Frequency:225.000Hz
 * Example Call: timer5_init();
 */
void timer5_init()
{
	TCCR5B = 0x00;	//Stop
	TCNT5H = 0xFF;	//Counter higher 8-bit value to which OCR5xH value is compared with
	TCNT5L = 0x01;	//Counter lower 8-bit value to which OCR5xH value is compared with
	OCR5AH = 0x00;	//Output compare register high value for Left Motor
	OCR5AL = 0xFF;	//Output compare register low value for Left Motor
	OCR5BH = 0x00;	//Output compare register high value for Right Motor
	OCR5BL = 0xFF;	//Output compare register low value for Right Motor
	OCR5CH = 0x00;	//Output compare register high value for Motor C1
	OCR5CL = 0xFF;	//Output compare register low value for Motor C1
	TCCR5A = 0xA9;	/*{COM5A1=1, COM5A0=0; COM5B1=1, COM5B0=0; COM5C1=1 COM5C0=0}
 					  For Overriding normal port functionality to OCRnA outputs.
				  	  {WGM51=0, WGM50=1} Along With WGM52 in TCCR5B for Selecting FAST PWM 8-bit Mode*/
	
	TCCR5B = 0x0B;	//WGM12=1; CS12=0, CS11=1, CS10=1 (Prescaler=64)
}

/*
 * Function Name: velocity
 * Input : left_motor -> 8 bit adc value for velocity for left motor
           right_motor -> 8 bit adc value for velocity for right motor
 * Output : None
 * Logic: 
    Function for robot velocity control using PWM
 * Example Call: velocity(200,150);
 */
void velocity (unsigned char left_motor, unsigned char right_motor)
{
	OCR5AL = (unsigned char)left_motor;
	OCR5BL = (unsigned char)right_motor;
}

/*
 * Function Name: angle_rotate
 * Input : Degrees
 * Output : None
 * Logic: Function used for turning robot by specified degrees with the help of position interrupts
 * Example Call: angle_rotate(90);
 */
void angle_rotate(unsigned int Degrees)
{
	float ReqdShaftCount = 0;
	unsigned long int ReqdShaftCountInt = 0;

	ReqdShaftCount = (float) Degrees/4.090; // division by resolution to get shaft count
	ReqdShaftCountInt = (unsigned int) ReqdShaftCount;
	ShaftCountRight = 0;
	ShaftCountLeft = 0;

	while (1)
	{
		if((ShaftCountRight >= ReqdShaftCountInt) || (ShaftCountLeft >= ReqdShaftCountInt))
		break;
	}
	stop(); //Stop robot
}

/*
 * Function Name: linear_distance_mm
 * Input : DistanceInMM,Speed
 * Output : None
 * Logic: Function used for moving robot forward by specified distance with specified velocity
 * Example Call: linear_distance_mm(170,100);
 */
void linear_distance_mm(unsigned int DistanceInMM,unsigned char speed)
{
	float ReqdShaftCount = 0;
	unsigned long int ReqdShaftCountInt = 0;

	ReqdShaftCount = DistanceInMM/5.338; // division by resolution to get shaft count
	ReqdShaftCountInt = (unsigned long int) ReqdShaftCount;
	ShaftCountRight = 0;
	ShaftCountLeft = 0;
	while(1)
	{
		if(ShaftCountRight>ShaftCountLeft) //Our Robot don't move in forward so maintain it in straight we are using this
		{
			velocity(speed,speed-25);
		}
		else if(ShaftCountRight<ShaftCountLeft)
		{
			velocity(speed-25,speed);
		}
		if(ShaftCountRight > ReqdShaftCountInt && ShaftCountLeft > ReqdShaftCountInt)
		{
			break;
		}
		else
		{
			velocity(speed,speed);
		}
	}
	stop(); //Stop robot
}

void forward_mm(unsigned int DistanceInMM,unsigned char speed)  //moving robot forward by specified distance with specified velocity
{
	forward();
	linear_distance_mm(DistanceInMM,speed);
}

void back_mm(unsigned int DistanceInMM)  //moving robot backward by specified distance with specified velocity
{
	back();
	linear_distance_mm(DistanceInMM,speed);
}

void left_degrees(unsigned int Degrees)  //rotate left by specified angle
{
	// 88 pulses for 360 degrees rotation 4.090 degrees per count
	left(); //Turn left
	angle_rotate(Degrees);
}

void right_degrees(unsigned int Degrees)  //rotate right by specified angle
{
	// 88 pulses for 360 degrees rotation 4.090 degrees per count
	right(); //Turn right
	angle_rotate(Degrees);
}

void soft_left_degrees(unsigned int Degrees)  //soft left by specified angle
{
	// 176 pulses for 360 degrees rotation 2.045 degrees per count
	soft_left(); //Turn soft left
	Degrees=Degrees*2;
	angle_rotate(Degrees);
}

void soft_right_degrees(unsigned int Degrees)  //soft right by specified angle
{
	// 176 pulses for 360 degrees rotation 2.045 degrees per count
	soft_right();  //Turn soft right
	Degrees=Degrees*2;
	angle_rotate(Degrees);
}

void soft_left_2_degrees(unsigned int Degrees)   //soft left_2 by specified angle
{
	// 176 pulses for 360 degrees rotation 2.045 degrees per count
	soft_left_2(); //Turn reverse soft left
	Degrees=Degrees*2;
	angle_rotate(Degrees);
}

void soft_right_2_degrees(unsigned int Degrees)  //soft right_2 by specified angle
{
	// 176 pulses for 360 degrees rotation 2.045 degrees per count
	soft_right_2();  //Turn reverse soft right
	Degrees=Degrees*2;
	angle_rotate(Degrees);
}

/*
 * Function Name: search_blk
 * Input : Degrees -> first rotaion to search black line
 * Output : None
 * Logic: Function used for searching black line in white region
 * Example Call: search_blk(20);
 */
void search_blk(unsigned int Degrees)
{
	float ReqdShaftCount = 0;
	unsigned long int ReqdShaftCountInt = 0;

	ReqdShaftCount = (float) Degrees/ 4.090; // division by resolution to get shaft count
	ReqdShaftCountInt = (unsigned int) ReqdShaftCount;
	ShaftCountRight = 0;
	ShaftCountLeft = 0;
	
	if (ADC_Conversion(2)>0x10)  //Center white line sensor is on black line
	{
		stop();
		lcd_wr_command(0x01);
		lcd_cursor(1,1);
		lcd_string("Black Found");
		_delay_ms(500);
		lcd_wr_command(0x01);
	}
	else
	{
		unsigned char flag = 0;
		stop();
		_delay_ms(500);
		right();
		lcd_wr_command(0x01);
		lcd_cursor(1,1);
		lcd_string("Searching Black");
		while (1)
		{
			if (ADC_Conversion(2)>0x10)  //Center white line sensor is on black line, Break loop
			{
				stop();
				break;
			}
			// Right rotation for angle degrees form main position and flag = 0
			if (ShaftCountLeft >= ReqdShaftCountInt && ShaftCountRight >= ReqdShaftCountInt && PORTA == 0x0A && flag == 0)
			{
				flag=1;
				stop();
				_delay_ms(500);
				left();
			}
			// Left rotation for angle 2*degrees form last position and flag = 1
			if (ShaftCountLeft >= (3*ReqdShaftCountInt) && ShaftCountRight >= (3*ReqdShaftCountInt) && PORTA == 0x05)
			{
				stop();
				_delay_ms(500);
				right();
			}
			// Right rotation for angle degrees form last position and flag = 1
			if (ShaftCountLeft >= (4*ReqdShaftCountInt) && ShaftCountRight >= (4*ReqdShaftCountInt) && PORTA == 0x0A && flag == 1)
			{
				flag=0;
				ShaftCountRight = 0;
				ShaftCountLeft = 0;
				ReqdShaftCountInt = ReqdShaftCountInt + 2;  //increment angle by 2*4.090
				right();
			}
		}
		stop();
		lcd_wr_command(0x01);
		lcd_cursor(1,1);
		lcd_string("Black Found");
		_delay_ms(500);
		lcd_wr_command(0x01);
	}
}

/*
 * Function Name: follow_blk
 * Input : Speed -> Avarage speed while moving on black line
 * Output : None
 * Logic: Function used to follow black line
 * Example Call: follow_blk(150);
 */
void follow_blk(unsigned char speed)
{
	while(1)
	{
		Left_white_line = ADC_Conversion(3);  //Getting data of Left WL Sensor
		Center_white_line = ADC_Conversion(2);  //Getting data of Center WL Sensor
		Right_white_line = ADC_Conversion(1);  //Getting data of Right WL Sensor
		// All white line sensor are on black surface then break loop
		if (Center_white_line>0x10 && Left_white_line>0x10 && Right_white_line>0x10)
		{
			stop();
			velocity(0,0);
			lcd_wr_command(0x01);
			lcd_cursor(1,1);
			lcd_string("Break");
			_delay_ms(500);
			lcd_wr_command(0x01);
			break;
		}
		
		if(Center_white_line>0x10)
		{
			forward();
			velocity(speed,speed);
		}

		if(Left_white_line<0x10 && Center_white_line<0x10)
		{
			forward();
			velocity(speed+20,speed-30);
		}

		if(Right_white_line<0x10 && Center_white_line<0x10)
		{
			forward();
			velocity(speed-30,speed+20);
		}
	}
}

/*
 * Function Name: follow_wall_l
 * Input : DistanceInMM -> Distance in mm
           Speed -> Avarage speed while moving on black line
 * Output : None
 * Logic: Function used to follow path using left sharp sensor only
 * Example Call: follow_wall_l(350,150);
 */
void follow_wall_l(unsigned int DistanceInMM,unsigned char speed)
{
	float ReqdShaftCount = 0;
	unsigned long int ReqdShaftCountInt = 0;

	ReqdShaftCount = DistanceInMM / 5.338; 
	ReqdShaftCountInt = (unsigned long int) ReqdShaftCount;
	ShaftCountRight = 0;
	ShaftCountLeft = 0;
	while (1)
	{
		sharp_l = Sharp_GP2D12_estimation(ADC_Conversion(9));
		lcd_print(1,1,sharp_l,3);
		lcd_print(2,1,l_thres,3);
		if(ShaftCountRight > ReqdShaftCountInt && ShaftCountLeft > ReqdShaftCountInt)
		{
			stop();
			velocity(0,0);
			lcd_wr_command(0x01);
			lcd_cursor(1,1);
			lcd_string("Over");
			_delay_ms(500);
			lcd_wr_command(0x01);
			break;
		}
		if (sharp_l>l_thres)
		{
			forward();
			velocity(speed-20,speed+30);
		}
		if (sharp_l<l_thres)
		{
			forward();
			velocity(speed+30,speed-20);
		}
	}
}

/*
 * Function Name: follow_wall_r
 * Input : DistanceInMM -> Distance in mm
           Speed -> Avarage speed while moving on black line
 * Output : None
 * Logic: Function used to follow path using right sharp sensor only
 * Example Call: follow_wall_r(350,150);
 */
void follow_wall_r(unsigned int DistanceInMM,unsigned char speed)
{
	float ReqdShaftCount = 0;
	unsigned long int ReqdShaftCountInt = 0;

	ReqdShaftCount = DistanceInMM / 5.338;
	ReqdShaftCountInt = (unsigned long int) ReqdShaftCount;
	ShaftCountRight = 0;
	ShaftCountLeft = 0;
	while (1)
	{
		sharp_r = Sharp_GP2D12_estimation(ADC_Conversion(13));
		lcd_print(1,1,sharp_r,3);
		lcd_print(2,1,r_thres,3);
		if(ShaftCountRight > ReqdShaftCountInt && ShaftCountLeft > ReqdShaftCountInt)
		{
			stop();
			velocity(0,0);
			lcd_wr_command(0x01);
			lcd_cursor(1,1);
			lcd_string("Over");
			_delay_ms(500);
			lcd_wr_command(0x01);
			break;
		}
		if (sharp_r>r_thres)
		{
			forward();
			velocity(speed+30,speed-20);
		}
		if (sharp_r<r_thres)
		{
			forward();
			velocity(speed-20,speed+30);
		}
	}
}

//Filter Selection
void filter_red(void)    //Used to select red filter
{
	//Filter Select - red filter
	PORTD = PORTD & 0xBF; //set S2 low
	PORTD = PORTD & 0x7F; //set S3 low
}

void filter_green(void)	//Used to select green filter
{
	//Filter Select - green filter
	PORTD = PORTD | 0x40; //set S2 High
	PORTD = PORTD | 0x80; //set S3 High
}

void filter_blue(void)	//Used to select blue filter
{
	//Filter Select - blue filter
	PORTD = PORTD & 0xBF; //set S2 low
	PORTD = PORTD | 0x80; //set S3 High
}

void filter_clear(void)	//select no filter
{
	//Filter Select - no filter
	PORTD = PORTD | 0x40; //set S2 High
	PORTD = PORTD & 0x7F; //set S3 Low
}

/*
 * Function Name: color_sensor_scaling
 * Input : None
 * Output : None
 * Logic: This function is used to select 100% scaling of original frequency of the output generated by the color sensor
 * Example Call: color_sensor_scaling();
 */
void color_sensor_scaling()
{
	PORTD = PORTD | 0x10; //set S0 high
	PORTD = PORTD | 0x20; //set S1 high
}

/*
 * Function Name: lcd_read
 * Input : None
 * Output : None
 * Logic: This function is used to select filters and display the count generated by the sensor on LCD.
 * Example Call: lcd_read();
 */
void lcd_read(void)
{
	//Red
	filter_red(); //select red filter
	pulse=0; //reset the count to 0
	_delay_ms(2); //capture the pulses for 100 ms or 0.1 second
	red = pulse;  //store the count in variable called red
	
	//Green
	filter_green(); //select green filter
	pulse=0; //reset the count to 0
	_delay_ms(2); //capture the pulses for 100 ms or 0.1 second
	green = pulse;  //store the count in variable called green
	
	//Blue
	filter_blue(); //select blue filter
	pulse=0; //reset the count to 0
	_delay_ms(2); //capture the pulses for 100 ms or 0.1 second
	blue = pulse;  //store the count in variable called blue
	
	//clear
	filter_clear(); //select clear filter
	pulse=0; //reset the count to 0
	_delay_ms(2); //capture the pulses for 100 ms or 0.1 second
	no_ff = pulse;  //store the count in variable called no_ff
	
	lcd_print(1,1,red,5);  //Print the count on second row
	lcd_print(1,9,green,5);
	lcd_print(2,1,blue,5);
	lcd_print(2,9,no_ff,5);
	_delay_ms(10);	// Display for 1000ms or 1 second
	lcd_wr_command(0x01); //Clear the LCD
}

/*
 * Function Name: rgb_blink
 * Input : None
 * Output : None
 * Logic: This function is used to blink RGB LED according to color of indicators.
 * Example Call: rgb_blink();
 */
void rgb_blink(void)
{
	PORTL = PORTL | 0x07;
	if(green<thres_green&&blue<thres_blue&&red<thres_red)  //all values are less then threshold values
	{
		PORTL = PORTL & 0x07;
	}
	else
	{
		highest=red;
		if(highest<green)
		{
			highest=green;
		}

		if(highest<blue)
		{
			highest=blue;
		}
		
		if(highest==red)
		PORTL = PORTL & 0x03; //glow red led
		else if(highest==green)
		PORTL = PORTL & 0x06;  //glow green led
		else if(highest==blue)
		PORTL = PORTL & 0x05;  //glow blue led
		_delay_ms(1000);
	}
	PORTL = PORTL & 0x07;
}

/*
 * Function Name: init_devices
 * Input : None
 * Output : None
 * Logic: Function to initialize all the devices
 * Example Call: init_devices();
 */
void init_devices()
{
	cli(); //Clears the global interrupt
	port_init();  //Initializes all the ports
	left_position_encoder_interrupt_init();
	right_position_encoder_interrupt_init();
	color_sensor_pin_interrupt_init();
	adc_init();
	timer5_init();
	sei();   // Enables the global interrupt
}

/*
 * Function Name: main
 * Input : None
 * Output : int to inform the caller that the program exited correctly or not
 * Logic: This function will do all the task to traverse through arena
 * Example Call: main();
 */

int main(void)
{
	init_devices(); //initialize all devices
	lcd_set_4bit();  //set lcd in 4 bit mode
	lcd_init();  //initialize lcd
	color_sensor_scaling();
	for (unsigned int i=0;i<4;i++)
	{
		_delay_ms(1000);
		l_thres = l_arr_thres[i];  //storing different values for room A,B,C,D
		r_thres = r_arr_thres[i];
		forward_mm(260,150);    //move 26cm forward from home position
		stop();
		_delay_ms(500);
		velocity(100,100);
		left_degrees(88);   //rotate left by 90 degree
		stop();
		_delay_ms(500);
		lcd_read();   //take red,green,blue values from indicator
		rgb_blink();  //blink led according to color of indicator
		velocity(100,100);
		right_degrees(84);  //rotate right by 87 degree
		stop(); 
		_delay_ms(500);
		forward_mm(300,200);
		follow_wall_r(250,130);  //move forward by 25cm
		stop();
		_delay_ms(500);
		velocity(100,100);
		soft_left_degrees(65);  //soft left by 65 degree
		stop();
		_delay_ms(500);
		lcd_read();   //take red,green,blue values from indicator
		rgb_blink();   //blink led according to color of indicator
		velocity(100,100);
		soft_right_2_degrees(65);   //soft right_2 by 65 degree
		stop();
		_delay_ms(500);
		velocity(100,100);
		right_degrees(174);   //turn right by angle of 176 degree
		stop();
		_delay_ms(500);
		follow_wall_l(310,130);  //move forward by 31cm
		stop();
		_delay_ms(500);
		stop();
		_delay_ms(500);
		velocity(100,100);
		search_blk(10);   //search black line on home position
		stop();
		_delay_ms(500);
		follow_blk(100);  //follow black line
		stop();
		_delay_ms(1000);
		forward_mm(60,100);
		stop();
		_delay_ms(500);
		velocity(100,100);
		left_degrees(100);   //left degrees by 100
		stop();
		_delay_ms(500);
		velocity(100,100);
		search_blk(30);  //search black line
		stop();
		_delay_ms(1000);
	}
	return 0;
}